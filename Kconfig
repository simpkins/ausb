## Kconfig
```kconfig
# Configuration file used for ESP-IDF when building for Espressif platforms.
menu "AUSB"
    config AUSB_HW_ESP
        bool
        default y
        help
            Support ESP32-S2 and ESP32-S3 USB OTG hardware.
    config AUSB_HW_MOCK
        bool "Support a mock USB hardware device."
        default n
        help
            Support a mock USB hardware device.  This is mainly useful for
            building unit tests.
    config AUSB_MAX_INTERFACES
        int "The maximum number of interfaces to support"
        default 6
        help
            The maximum number of interfaces to support in a single
            USB device configuration.
endmenu #AUSB
```
